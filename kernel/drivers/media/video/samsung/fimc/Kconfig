## kernel/drivers/media/video/samsung/fimc/Kconfig
```kconfig
config VIDEO_FIMC
	bool "Samsung Camera Interface (FIMC) driver"
	depends on VIDEO_SAMSUNG && ARCH_S5PV210
	default n
	help
	  This is a video4linux driver for Samsung FIMC device.

choice
depends on VIDEO_FIMC
prompt "Select Camera"
default CAMERA_OV3640
config CAMERA_OV3640
        bool "camera ov3640"
        depends on VIDEO_FIMC
        help
          camera ov3640 for s5pv210

#config OV965X
config CAMERA_OV9650
	bool "OVT OV965X"
	depends on VIDEO_FIMC
	---help---
	  LYT OV965X camera module support for s5pv210

config CAMERA_TVP5150_MODULE
        bool "camera tvp5150 module"
        depends on VIDEO_FIMC
        help
          onboard camera tvp5150 module for s5pv210        
endchoice
#bs add ov965x
choice
depends on OV965X
prompt "Select source resolution"
default OV965X_VGA
config OV965X_VGA
	bool "VGA(640X480)"
	---help---
	LIYUTAI OV965X camera module support.

config OV965X_QVGA
	bool "QVGA(320X240)"
	---help---
	LIYUTAI OV965X camera module support.

config OV965X_SVGA
	bool "SVGA(800X600)"
	---help---
	LIYUTAI OV965X camera module support.

config OV965X_SXGA
	bool "SXGA(1280X1024)"
	---help---
	LIYUTAI OV965X camera module support.
endchoice
#bs add ov965x
choice
depends on VIDEO_FIMC
prompt "Select CSC Range config"
default VIDEO_FIMC_RANGE_NARROW
config VIDEO_FIMC_RANGE_NARROW
	bool "Narrow"
	depends on VIDEO_FIMC && ARCH_S5PV210
	---help---
	  RGB <-> YUV Color Conversion Narrow Range Equation

config VIDEO_FIMC_RANGE_WIDE
	bool "Wide"
	depends on VIDEO_FIMC && ARCH_S5PV210
	---help---
	  RGB <-> YUV Color Conversion Wide Range Equation
endchoice	

config VIDEO_FIMC_DEBUG
	bool "FIMC driver debug messages"
	depends on VIDEO_FIMC

config VIDEO_FIMC_MIPI
	bool "MIPI-CSI2 Slave Interface support"
	depends on VIDEO_FIMC && ARCH_S5PV210
	default y
```
